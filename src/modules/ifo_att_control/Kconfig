## src/modules/ifo_att_control/Kconfig
```kconfig
menuconfig MODULES_IFO_ATT_CONTROL
	bool "ifo_att_control"
	default n
	---help---
		Enable support for ifo_att_control

menuconfig USER_IFO_ATT_CONTROL
	bool "ifo_att_control running as userspace module"
	default y
	depends on BOARD_PROTECTED && MODULES_IFO_ATT_CONTROL
	---help---
		Put ifo_att_control in userspace memory
```

## src/modules/ifo_level_adapter/Kconfig
```kconfig
menuconfig MODULES_IFO_LEVEL_ADAPTER
	bool "ifo_level_adapter"
	default n
	---help---
		Enable the IFODRONE level adapter: bridges the stock mc_pos_control (vtol
		virtual attitude setpoint) to the stock mc_att_control, rewriting the tilted
		attitude setpoint into a level attitude setpoint + body-frame thrust so the
		IFODRONE body stays level while translating via the side EDFs.

menuconfig USER_IFO_LEVEL_ADAPTER
	bool "ifo_level_adapter running as userspace module"
	default y
	depends on BOARD_PROTECTED && MODULES_IFO_LEVEL_ADAPTER
	---help---
		Put ifo_level_adapter in userspace memory
```

## src/modules/ifo_pos_control/Kconfig
```kconfig
menuconfig MODULES_IFO_POS_CONTROL
	bool "ifo_pos_control"
	default n
	---help---
		Enable IFODRONE position controller module
```

## src/modules/ifo_rate_control/Kconfig
```kconfig
menuconfig MODULES_IFO_RATE_CONTROL
	bool "ifo_rate_control"
	default n
	---help---
		Enable support for ifo_rate_control

menuconfig USER_IFO_RATE_CONTROL
	bool "ifo_rate_control running as userspace module"
	default y
	depends on BOARD_PROTECTED && MODULES_IFO_RATE_CONTROL
	---help---
		Put ifo_rate_control in userspace memory
```
